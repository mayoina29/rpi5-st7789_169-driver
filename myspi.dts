/ts-v1/;
/plugin/;

/ {
	compatible = "brcm,bcm2835";
	
	fragment@0 {
		target = <&spi0>;
		__overlay__{
			status = "okay";
			spidev@0{
		        status = "disabled";
            };

            st7789v2@0 {
                compatible = "my,st7789v2";
                reg = <0>;
                spi-max-frequency = <32000000>;
                rotate = <90>;
                fps = <60>;

                reset-gpios = <&gpio 27 0>;
                dc-gpios = <&gpio 25 0>;
            };
        };
    };
};
